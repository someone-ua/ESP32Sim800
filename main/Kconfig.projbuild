## main/Kconfig.projbuild
```kconfig
menu "DB Webserver Configuration"

    choice WEB_DEPLOY_MODE
        prompt "Website deploy mode"
        default WEB_DEPLOY_SF
        help
            Select website deploy mode.
            You can deploy website to host, and ESP32 will retrieve them in a semihost way (JTAG is needed).
            You can deploy website to SD card or SPI flash, and ESP32 will retrieve them via SDIO/SPI interface.
            Detailed operation steps are listed in the example README file.
        config WEB_DEPLOY_SEMIHOST
            bool "Deploy website to host (JTAG is needed)"
            help
                Deploy website to host.
                It is recommended to choose this mode during developing.
        config WEB_DEPLOY_SF
            bool "Deploy website to SPI Nor Flash"
            help
                Deploy website to SPI Nor Flash.
                Choose this in production mode or if the size of website is small (less than 2MB).
    endchoice

    if WEB_DEPLOY_SEMIHOST
        config HOST_PATH_TO_MOUNT
            string "Host path to mount (e.g. absolute path to web dist directory)"
            default "PATH-TO-WEB-DIST_DIR"
            help
                When using semihost in ESP32, you should specify the host path which will be mounted to VFS.
                Note that only absolute path is acceptable.
    endif

    config WEB_MOUNT_POINT
        string "Website mount point in VFS"
        default "/www"
        help
            Specify the mount point in VFS.

endmenu

menu "Modem Configuration"

    config  MODEM_INET_SERVER_IP
        string "Intenet Server IP"
        default "0.0.0.0"
        help
            IP address of remove server
    config  MODEM_INET_SERVER_PORT
        int "Internet Server Port"
        default 14550
        help
            Port number of remote server
    config MODEM_PPP_APN
        string "Set MODEM APN"
        default "internet"
        help
            Set APN (Access Point Name), a logical name to choose data network

    config MODEM_PPP_AUTH_USERNAME
        string "Set username for authentication"
        default "espressif"
        depends on !EXAMPLE_MODEM_PPP_AUTH_NONE
        help
            Set username for PPP Authentication.

    config MODEM_PPP_AUTH_PASSWORD
        string "Set password for authentication"
        default "esp32"
        depends on !EXAMPLE_MODEM_PPP_AUTH_NONE
        help
            Set password for PPP Authentication.

    config MODEM_PPP_AUTH_NONE
        bool "Skip PPP authentication"
        default n
        help
            Set to true for the PPP client to skip authentication

    config NEED_SIM_PIN
        bool "SIM PIN needed"
        default n
        help
            Enable to set SIM PIN before starting the example

    config SIM_PIN
        string "Set SIM PIN"
        default "1234"
        depends on CONFIG_NEED_SIM_PIN
        help
            Pin to unlock the SIM

    menu "UART Configuration"
        config MODEM_UART_TX_PIN
            int "TXD Pin Number"
            default 27
            range 0 31
            help
                Pin number of UART TX.

        config MODEM_UART_RX_PIN
            int "RXD Pin Number"
            default 26
            range 0 31
            help
                Pin number of UART RX.
        config MODEM_POWER_PIN
            int "Modem Power Pin Number"
            default 23
            range  0 31
            help
                Pin number of Modem power
        config  MODEM_RESET_PIN
            int "Modem Reset Pin"
            default 5
            range 0 31
            help
                Pin number of Modem reset
        config  MODEM_PWKEY_PIN
            int "Modem Power Key Pin"
            default 4
            range  0 31
            help
                Pin number of Modem power key
    endmenu

endmenu
```

## sdkconfig.defaults
```kconfig
CONFIG_HTTPD_MAX_REQ_HDR_LEN=1024
CONFIG_SPIFFS_OBJ_NAME_LEN=64
CONFIG_FATFS_LONG_FILENAME=y
CONFIG_FATFS_LFN_HEAP=y
CONFIG_PARTITION_TABLE_CUSTOM=y
CONFIG_PARTITION_TABLE_CUSTOM_FILENAME="partitions.csv"
CONFIG_PARTITION_TABLE_FILENAME="partitions.csv"
CONFIG_PPP_SUPPORT=y
CONFIG_ESPTOOLPY_FLASHFREQ_80M=y
CONFIG_ESPTOOLPY_FLASHFREQ="80m"
CONFIG_ESPTOOLPY_FLASHSIZE_4MB=y
CONFIG_ESPTOOLPY_FLASHSIZE="4MB"
CONFIG_ETH_TRANSMIT_MUTEX=y
CONFIG_ESP_HTTP_CLIENT_ENABLE_DIGEST_AUTH=y
```
